## u-boot-2015.07/configs/am335x_adv_defconfig
```kconfig
CONFIG_ARM=y
CONFIG_TARGET_AM335X_ADVANTECH=y
CONFIG_SPL=y
CONFIG_SPL_STACK_R=y
CONFIG_SPL_STACK_R_ADDR=0x82000000
CONFIG_SYS_EXTRA_OPTIONS="NAND, ENV_IS_IN_NAND, MTD_DEBUG, MTD_DEBUG_VERBOSE=3"
# CONFIG_CMD_IMLS is not set
# CONFIG_CMD_FLASH is not set
# CONFIG_CMD_SETEXPR is not set
CONFIG_SPI_FLASH=y
```
